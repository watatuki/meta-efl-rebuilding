## conf/layer.conf
```bitbake
# We have a conf and classes directory, append to BBPATH 
BBPATH .= ":${LAYERDIR}"

# We have a recipes directory, add to BBFILES
BBFILES += "${LAYERDIR}/recipes-*/*/*.bb ${LAYERDIR}/recipes-*/*/*.bbappend"

BBFILE_COLLECTIONS += "efl-rebuilding"
BBFILE_PATTERN_efl-rebuilding := "^${LAYERDIR}/"
BBFILE_PRIORITY_efl-rebuilding = "7"

# This should only be incremented on significant changes that will
# cause compatibility issues with other layers
LAYERVERSION_efl-layer = "1"

E_MIRROR = "http://download.enlightenment.org/releases"
E_RELEASES = "http://download.enlightenment.org/rel"
E_SVN = "svn://svn.enlightenment.org/svn/e"
```
